#include <input/processors/runtime-input-processor.dtsi>

/ {
    mouse_runtime_input_processor_central: mouse_runtime_input_processor_central {
        compatible = "zmk,input-processor-runtime";
        processor-label = "central";
        type = <INPUT_EV_REL>;
        x-codes = <INPUT_REL_X>;
        y-codes = <INPUT_REL_Y>;
        scale-multiplier = <1>;
        scale-divisor = <1>;
        rotation-degrees = <0>;
        track-remainders;

        // AUTO MOUSE: right (central) trackball activates L3 after 100 ms.
        // Inactivity returns to the typing layer after 1500 ms.
        // Persisted DYA Studio overrides can supersede these defaults.
        temp-layer-enabled;
        temp-layer = <3>;
        temp-layer-activation-delay-ms = <100>;
        temp-layer-deactivation-delay-ms = <1500>;

        temp-layer-transparent-behavior = <&trans>;
        temp-layer-kp-behavior = <&kp>;
        temp-layer-keep-keycodes = <LEFT_CONTROL LEFT_SHIFT LEFT_ALT LEFT_GUI RIGHT_CONTROL RIGHT_SHIFT RIGHT_ALT RIGHT_GUI>;

        #input-processor-cells = <0>;
    };

    mouse_runtime_input_processor_peripheral: mouse_runtime_input_processor_peripheral {
        compatible = "zmk,input-processor-runtime";
        processor-label = "periph";
        type = <INPUT_EV_REL>;
        x-codes = <INPUT_REL_X>;
        y-codes = <INPUT_REL_Y>;
        scale-multiplier = <1>;
        scale-divisor = <1>;
        rotation-degrees = <0>;
        track-remainders;

        temp-layer-transparent-behavior = <&trans>;
        temp-layer-kp-behavior = <&kp>;
        temp-layer-keep-keycodes = <LEFT_CONTROL LEFT_SHIFT LEFT_ALT LEFT_GUI RIGHT_CONTROL RIGHT_SHIFT RIGHT_ALT RIGHT_GUI>;

        #input-processor-cells = <0>;
    };
};